## layers/meta-balena-nanopi-r2c/conf/layer.conf
```bitbake
BBPATH .= ":${LAYERDIR}"

BBFILES += "${LAYERDIR}/recipes-*/*/*.bb \
            ${LAYERDIR}/recipes-*/*/*.bbappend"

BBFILE_COLLECTIONS += "balena-nanopi-r2c"
BBFILE_PATTERN_balena-nanopi-r2c := "^${LAYERDIR}/"
BBFILE_PRIORITY_balena-nanopi-r2c = "1337"
```

## layers/meta-balena-nanopi-r2c/conf/machine/nanopi-r2c.conf
```bitbake
#@TYPE: Machine
#@NAME: nanopi-r2c
#@DESCRIPTION: Machine configuration for the FriendlyARM NanoPi R2C, based on the Rockchip RK3328 SoC

require conf/machine/nanopi-r2s.conf

PREFERRED_PROVIDER_virtual/kernel = "linux-rockchip"
PREFERRED_VERSION_linux-rockchip = "5.15%"

KBUILD_DEFCONFIG = "nanopi-r2_linux_defconfig"
KERNEL_DEVICETREE = "rockchip/rk3328-nanopi-r2-rev06.dtb"
```
